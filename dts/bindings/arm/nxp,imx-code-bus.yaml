## dts/bindings/arm/nxp,imx-code-bus.yaml
```yaml
#
# Copyright (c) 2019, Diego Sueiro
#
# SPDX-License-Identifier: Apache-2.0
#
---
title: i.MX M4 Code Bus
version: 0.1

description: >
  This binding gives a base representation of the i.MX M4 Code Bus

inherits:
  !include base.yaml

properties:
    compatible:
      constraint: "nxp,imx-code-bus"

    reg:
      category: required

...
```

## dts/bindings/arm/nxp,imx-sys-bus.yaml
```yaml
#
# Copyright (c) 2019, Diego Sueiro
#
# SPDX-License-Identifier: Apache-2.0
#
---
title: i.MX M4 System Bus
version: 0.1

description: >
  This binding gives a base representation of the i.MX M4 System Bus

inherits:
  !include base.yaml

properties:
    compatible:
      constraint: "nxp,imx-sys-bus"

    reg:
      category: required

...
```
